/* SPDX-License-Identifier: Apache-2.0 */

/dts-v1/;

#include "virt-riscv32.dtsi"

/ {
	chosen {
		zephyr,console = &uart_new;
		zephyr,shell-uart = &uart_new;
		zephyr,sram = &ram0;
	};
	uart_new: uart@10009000 {
		compatible = "pydrofoil,nrf-uart";
		reg = <0x10009000 0x1000>;
	};

};

&ram0 {
	reg = <0x80000000 0x10000000>;
};

/*
&clint {
	status = "disabled";
};

&mtimer {
	status = "disabled";
};

&plic {
	status = "okay";
	interrupts-extended = <&hlic0 0x0b>; 
};
*/