## zephyr_testing/zephyr_modules/custom_display/drivers/display/custom_display/Kconfig
```kconfig
config CUSTOM_DISPLAY
    bool "Custom VCML RAM Framebuffer Display Driver"
    default y
    depends on DT_HAS_CUSTOM_DISPLAY_ENABLED
    select DISPLAY_SYSMEM if LVGL
    help
      Enable the out-of-tree RAM framebuffer driver for VCML simulations.
```

## zephyr_testing/zephyr_modules/custom_display/dts/bindings/display/custom,display.yaml
```yaml
description: Custom VCML RAM Framebuffer Display

compatible: "custom,display"

include: base.yaml

properties:
  width:
    type: int
    required: true
    description: Width of the framebuffer in pixels

  height:
    type: int
    required: true
    description: Height of the framebuffer in pixels

  memory-region:
    type: phandle
    required: true
    description: Pointer to the reserved RAM region for the framebuffer
```

## zephyr_testing/zephyr_modules/custom_virtio/drivers/virtio/Kconfig
```kconfig
# zephyr_modules/custom_virtio/drivers/virtio/Kconfig
rsource "custom_virtio/Kconfig"
```

## zephyr_testing/zephyr_modules/custom_virtio/drivers/virtio/custom_virtio/Kconfig
```kconfig
config CUSTOM_VIRTIO_MMIO
    bool "Custom Virtio MMIO Transport Driver"
    default y
    depends on DT_HAS_CUSTOM_VIRTIO_MMIO_ENABLED
    help
      Enable the out-of-tree Virtio MMIO transport driver for VCML simulations.
```

## zephyr_testing/zephyr_modules/custom_virtio/dts/bindings/display/custom,virtio-mmio.yaml
```yaml
description: Custom Virtio MMIO Transport Device

compatible: "custom,virtio-mmio"

include: base.yaml

properties:
  reg:
    required: true
    description: Physical memory address and size of the MMIO registers

  interrupts:
    required: true
    description: The hardware interrupt line connected to the PLIC
```

## zephyr_testing/zephyr_modules/custom_virtio_input/drivers/input/custom_virtio_input/Kconfig
```kconfig
config CUSTOM_VIRTIO_INPUT
    bool "Custom Virtio Input Driver"
    default y
    depends on DT_HAS_CUSTOM_VIRTIO_INPUT_ENABLED
    select INPUT
    help
      Enable the out-of-tree Virtio Input driver (keyboard/mouse) for VCML.
```

## zephyr_testing/zephyr_modules/custom_virtio_input/dts/bindings/display/custom,virtio-input.yaml
```yaml
description: Custom Virtio Input Device

compatible: "custom,virtio-input"

include: base.yaml
```
