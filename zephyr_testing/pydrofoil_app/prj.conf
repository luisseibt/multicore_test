## CMakeLists.txt
```
# SPDX-License-Identifier: Apache-2.0

# 1. Require a modern CMake version (matches Zephyr's requirements)
cmake_minimum_required(VERSION 3.20.0)

# 2. Inject your custom out-of-tree hardware modules BEFORE finding Zephyr.
# This ensures Zephyr's build system discovers your custom_uart Kconfig 
# and CMakeLists.txt during its initial workspace scan.
list(APPEND EXTRA_ZEPHYR_MODULES /home/seibt/thesis/bare_metal_tests/zephyr_testing/zephyr_modules/custom_uart)


# 3. Pull in the Zephyr OS build system
find_package(Zephyr REQUIRED HINTS $ENV{ZEPHYR_BASE})

# 4. Name your application project
project(pydrofoil_app)

# 5. Add your source files to the Zephyr 'app' target
target_sources(app PRIVATE src/main.c)
```

## prj.conf
```kconfig
CONFIG_SERIAL=y
CONFIG_UART_PYDROFOIL=y
CONFIG_SYS_CLOCK_EXISTS=n
CONFIG_RISCV_PMP=n
CONFIG_PLIC=n
CONFIG_MULTI_LEVEL_INTERRUPTS=n
```

## src/main.c
```c
#include <stdint.h>
#include <stdio.h>

// /* Use 'used' and ensure they are global (no static) */
// __attribute__((used, section(".data"), aligned(16)))
// volatile uint64_t tohost = 0;

// __attribute__((used, section(".data"), aligned(16)))
// volatile uint64_t fromhost = 0;

int main(void)
{
    /* FAKE USE: This prevents the linker from garbage collecting the symbols */
    // if (tohost > 0) {
    //     printf("This will never happen, but the linker doesn't know that: %llu", tohost);
    // }

    printf("Hello World! %s\n", CONFIG_BOARD_TARGET);

    return 0;
}
```
