## boards/pydrofoil_32/Kconfig.pydrofoil_32
```kconfig
# Copyright (c) 2024 Antmicro <www.antmicro.com>
# SPDX-License-Identifier: Apache-2.0

config BOARD_PYDROFOIL_32
	select SOC_QEMU_VIRT_RISCV32
```

## boards/pydrofoil_32/board.yml
```yaml
board:
  name: pydrofoil_32
  full_name: Pydrofoil 32-bit Virtual Prototype
  vendor: qemu
  socs:
    - name: qemu_virt_riscv32
```
